## conf/layer.conf
```bitbake
# We have a conf and classes directory, add to BBPATH
BBPATH =. "${LAYERDIR}:"

# We have recipes-* directories, add to BBFILES
BBFILES += "${LAYERDIR}/recipes-*/*/*.bb \
            ${LAYERDIR}/recipes-*/*/*.bbappend"

BBFILE_COLLECTIONS += "agldemo"
BBFILE_PATTERN_agldemo = "^${LAYERDIR}/"
BBFILE_PRIORITY_agldemo = "70"

BBFILES_DYNAMIC += " \
    aglcontainermc:${LAYERDIR}/dynamic-layers/meta-agl-ic-container/*/*/*.bb \
    aglcontainermc:${LAYERDIR}/dynamic-layers/meta-agl-ic-container/*/*/*.bbappend \
"

LICENSE_PATH += "${LAYERDIR}/licenses"

LAYERSERIES_COMPAT_agldemo = "scarthgap"

LAYERDEPENDS_agldemo = "aglcore qt6-layer openembedded-layer networking-layer multimedia-layer flutter-layer meta-app-framework"

########### WORKAROUND FOR MESON and QT6 ############
QT6_INSTALL_LIBEXECDIR := "${bindir}"
```

## meta-agl-demo-control-panel/conf/layer.conf
```bitbake
# We have a conf and classes directory, add to BBPATH
BBPATH =. "${LAYERDIR}:"

# We have recipes-* directories, add to BBFILES
BBFILES += "${LAYERDIR}/recipes-*/*/*.bb \
            ${LAYERDIR}/recipes-*/*/*.bbappend"

BBFILES_DYNAMIC += " \
    qt6-layer:${LAYERDIR}/dynamic-layers/meta-qt6/*/*/*.bbappend \
"

BBFILE_COLLECTIONS += "agldemocontrolpanel"
BBFILE_PATTERN_agldemocontrolpanel = "^${LAYERDIR}/"
BBFILE_PRIORITY_agldemocontrolpanel = "70"

LAYERSERIES_COMPAT_agldemocontrolpanel = "scarthgap"

LAYERDEPENDS_agldemocontrolpanel = "aglcore qt6-layer networking-layer"
```

## meta-agl-html5-demo/conf/layer.conf
```bitbake
# We have a conf and classes directory, add to BBPATH
BBPATH =. "${LAYERDIR}:"

# We have recipes-* directories, add to BBFILES
BBFILES += "${LAYERDIR}/recipes-*/*/*.bb \
            ${LAYERDIR}/recipes-*/*/*.bbappend"

BBFILE_COLLECTIONS += "agl-html5-demo-layer"
BBFILE_PATTERN_agl-html5-demo-layer = "^${LAYERDIR}/"
BBFILE_PRIORITY_agl-html5-demo-layer = "70"

LAYERSERIES_COMPAT_agl-html5-demo-layer = "scarthgap"

LAYERDEPENDS_agl-html5-demo-layer = "agldemo"
```

## meta-agl-kvm-demo/conf/layer.conf
```bitbake
# We have a conf and classes directory, add to BBPATH
BBPATH =. "${LAYERDIR}:"

# We have recipes-* directories, add to BBFILES
BBFILES += "${LAYERDIR}/recipes-*/*/*.bb \
            ${LAYERDIR}/recipes-*/*/*.bbappend"

BBFILE_COLLECTIONS += "agl-kvm-demo-layer"
BBFILE_PATTERN_agl-kvm-demo-layer = "^${LAYERDIR}/"
BBFILE_PRIORITY_agl-kvm-demo-layer = "70"

LAYERSERIES_COMPAT_agl-kvm-demo-layer = "scarthgap"

LAYERDEPENDS_agl-kvm-demo-layer = "agldemo"
```
